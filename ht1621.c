#include "ht1621.h"

#define _Nop()	;

//char Ht1621Tab[]={0x00,0x00,0x00,0x00,0x00,0x00,0x00,0x00,0x00,0x00,0x00,0x00,0x00,0x00,0x00,0x00};

/********************************************************
函数名称：void ht1621_init(void)
功能描述: HT1621初始化
全局变量：无
参数说明：无
返回说明：无
版 本：1.0
说 明：初始化后，液晶屏所有字段均显示
********************************************************/
void ht1621_init(void)
{
	HT1621_CS=1;
	HT1621_WR=1;
	HT1621_DAT=1;
	//DelayMS(2000); //延时使LCD工作电压稳定
	ht1621_wr_cmd(HT_LCD_BIAS);
	ht1621_wr_cmd(HT_USE_RC256); //使用内部振荡器
	ht1621_wr_cmd(HT_SYS_OFF);
	ht1621_wr_cmd(HT_WDT_OFF);
	ht1621_wr_cmd(HT_SYS_ON);
	ht1621_wr_cmd(HT_LCD_ON);
}

/******************************************************
写数据函数,cnt为传送数据位数,数据传送为低位在前
*******************************************************/
void ht1621_wr_dat(char dat,char cnt)
{
	char i;
	for (i=0;i<cnt;i++)
	{
		HT1621_WR=0;
		_Nop();
		HT1621_DAT=dat&0x80;
		_Nop();
		HT1621_WR=1;
		_Nop();
		dat<<=1;
	}

}

/********************************************************
函数名称：void ht1621_wr_cmd(char Cmd)
功能描述: HT1621命令写入函数
全局变量：无
参数说明：Cmd为写入命令数据
返回说明：无

说 明：写入命令标识位100
********************************************************/
void ht1621_wr_cmd(char cmd)
{
	HT1621_CS=0;
	_Nop();
	ht1621_wr_dat(0x80,4); //写入命令标志100
	ht1621_wr_dat(cmd,8); //写入命令数据
	HT1621_CS=1;
	_Nop();
}

/********************************************************
函数名称：void ht1621_wr_one(char addr,char dat)
功能描述: HT1621在指定地址写入数据函数
全局变量：无
参数说明：addr为写入初始地址SEG[31:0]，Data为写入数据COM[3:0]
返回说明：无
说 明：因为HT1621的数据位4位，所以实际写入数据为参数的后4位
********************************************************/
void ht1621_wr_one(char addr,char dat)//
{
	HT1621_CS=0;
	ht1621_wr_dat(0xa0,3); //写入数据标志101
	ht1621_wr_dat(addr<<2,6); //写入地址数据
	ht1621_wr_dat(dat<<4,4); //写入数据
	HT1621_CS=1;
	_Nop();
}

/********************************************************
HT1621测试程序，2008-2-13, 22:41:43
函数名称：void ht1621_wr_cnt(char addr,char *p,char cnt)
功能描述: HT1621连续写入方式函数
全局变量：无
参数说明：addr为写入初始地址，*p为连续写入数据指针，
cnt为写入数据总数
返回说明：无
说 明：HT1621的数据位4位，此处每次数据为8位，写入数据
总数按8位计算
********************************************************/
void ht1621_wr_cnt(char addr,char *p,char cnt)
{
	char i;
	HT1621_CS=0;
	ht1621_wr_dat(0xa0,3); //写入数据标志101
	ht1621_wr_dat(addr<<2,6); //写入地址数据
	for (i=0;i<cnt;i++)
	{
		ht1621_wr_dat(*p,8); //写入数据
		p++;
	}
	HT1621_CS=1;
	_Nop();
}

void ht1621_clr_lcd(void)//clear lcd
{
	HT1621_CS=0;
	ht1621_wr_dat(0xa0,3);          //写入数据标志101
	ht1621_wr_dat(0x00<<2,6);       //写入地址数据
	for (char i=0;i<16;i++)
	{
		ht1621_wr_dat(0x00,8);      //写入数据
	}
	HT1621_CS=1;
}
